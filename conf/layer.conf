## conf/layer.conf
```bitbake
BBPATH .= ":${LAYERDIR}"

BBFILES += "${LAYERDIR}/recipes-*/*/*.bb \
            ${LAYERDIR}/recipes-*/*/*.bbappend"

BBFILE_COLLECTIONS += "balena-rpi-sb"
BBFILE_PATTERN_balena-rpi-sb := "^${LAYERDIR}/"
BBFILE_PRIORITY_balena-rpi-sb = "1337"

LAYERSERIES_COMPAT_balena-rpi-sb = "kirkstone"
```
